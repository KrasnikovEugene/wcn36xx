## Kconfig
```kconfig
config WCN36XX
	tristate "Qualcomm Atheros WCN3660/3680 support"
	depends on MAC80211
	---help---
	  This module adds support for wireless adapters based on
	  Qualcomm Atheros WCN3660 and WCN3680 mobile chipsets.

	  If you choose to build a module, it'll be called wcn36xx.
```
